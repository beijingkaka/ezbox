## bootstrap/package/ezcfg/Config.in
```kconfig
menu "Configuration"
	depends on PACKAGE_ezcfg

source "package/ezcfg/config/Config.in"

endmenu
```

## bootstrap/package/ezcfg/config/Config.in
```kconfig
#
# For a description of the syntax of this configuration file,
# see scripts/kbuild/config-language.txt.
#

menu "ezcfg Settings"

choice
	prompt "Target Distro"
	default EZCFG_EZBOX_DISTRO_KUAFU
	help
	  Please select your target ezbox distro.

config EZCFG_EZBOX_DISTRO_KUAFU
	bool "Kuafu"
	help
	  ezbox Kuafu distro is for Linux embedded-system study purpose.

config EZCFG_EZBOX_DISTRO_HUANGDI
	bool "Huangdi"
	help
	  ezbox Huangdi distro is an all-in-one system.

config EZCFG_EZBOX_DISTRO_JINGWEI
	bool "Jingwei"
	help
	  ezbox Jingwei distro is for VoIP service gateway.

config EZCFG_EZBOX_DISTRO_QIAOCHUI
	bool "Qiaochui"
	help
	  ezbox Qiaochui distro is for CNC machine control.

config EZCFG_EZBOX_DISTRO_LILOU
	bool "Lilou"
	help
	  ezbox LiLou distro is for intelligent home security system.

config EZCFG_EZBOX_DISTRO_FUXI
	bool "Fuxi"
	help
	  ezbox Fuxi distro is for intelligent host keeper system.

config EZCFG_EZBOX_DISTRO_ZHUANXU
	bool "Zhuanxu"
	help
	  ezbox Zhuanxu distro is for virtual private server.

endchoice

config EZCFG_EZBOX_SYSUP
	bool "Static /init"
	default n
	help
	  Use static linked /init for system up.

endmenu

comment "Network Interfaces"
source "package/ezcfg/config/nic/Config.in"

comment "Utilities"
source "package/ezcfg/config/igrs/Config.in"
```

## bootstrap/package/ezcfg/config/igrs/Config.in
```kconfig
#
# For a description of the syntax of this configuration file,
# see scripts/kbuild/config-language.txt.
#

menu "ezcfg IGRS Utilities"

endmenu
```

## bootstrap/package/ezcfg/config/nic/Config.in
```kconfig
#
# For a description of the syntax of this configuration file,
# see scripts/kbuild/config-language.txt.
#

menu "ezcfg Network Interfaces"

config EZCFG_EZBOX_ETH_LAN_NIC
	bool "LAN Ethernet interface"
	default y
	help
	  Enable LAN side Ethernet interface.

config EZCFG_EZBOX_WIFI_LAN_NIC
	bool "LAN Wifi interface"
	default y
	help
	  Enable LAN side Wifi interface.

config EZCFG_EZBOX_BR_LAN_NIC
	bool "LAN bridge interface"
	default y
	help
	  Enable LAN side bridge interface.

config EZCFG_EZBOX_LAN_NIC
	bool "LAN network interface"
	default y
	help
	  Enable LAN side network interface.

config EZCFG_EZBOX_WAN_NIC
	bool "WAN network interface"
	default y
	help
	  Enable WAN side network interface.

endmenu
```

## pool/bootstrap/target/linux/cx9461x/files-2.6.32/arch/arm/mach-solos/Kconfig
```kconfig
if ARCH_SOLOS

menu "Solos Implementations"

comment "Solos Chip Type"

choice
	prompt "Solos Chip Type Selection"

config ARCH_SOLOS_GALLUS
	bool "Solos 45xx (Gallus)"

config ARCH_SOLOSW_GALLUS
	bool "Solos-W 46xx"

endchoice

comment "Pin Configuration"

choice
	prompt "Solos 45xx (Gallus)" if ARCH_SOLOS_GALLUS
	depends ARCH_SOLOS_GALLUS

config ARCH_SOLOS_228PIN
	bool "Solos 4510 (228-pin) " if ARCH_SOLOS_GALLUS
	depends on ARCH_SOLOS_GALLUS

config ARCH_SOLOS_376PIN
	bool "Solos 4515 (376-pin) " if ARCH_SOLOS_GALLUS
	depends on ARCH_SOLOS_GALLUS

endchoice

choice
	prompt "Solos 46xx" if ARCH_SOLOSW_GALLUS
	depends ARCH_SOLOSW_GALLUS

config ARCH_SOLOS_208PIN
	bool "Solos 4610 (208-pin) " if ARCH_SOLOSW_GALLUS
	depends on ARCH_SOLOSW_GALLUS

config ARCH_SOLOS_324PIN
	bool "Solos 4615 (324-pin) " if ARCH_SOLOSW_GALLUS
	depends on ARCH_SOLOSW_GALLUS

endchoice

endmenu
        

menu "Solos board type"
	
comment "Solos Board Type"

config MACH_SOLOS_GALLUSBU
	bool "Gallus Bring-up Board"
	depends on ARCH_SOLOS_GALLUS || ARCH_SOLOSW_GALLUS
	help
          Gallus bring-up board support. Say Y here if you
          have such a board.

config MACH_SOLOS_AEP
        bool "Gallus AEP Prototyping System" 
        depends on ARCH_SOLOS_GALLUS || ARCH_SOLOSW_GALLUS
        help
           If you need to look at the help this is the wrong
           board.

config SOLOS_SPI
	bool "Gallus SPI bus support" 
	default y
	depends on ARCH_SOLOS_GALLUS || ARCH_SOLOSW_GALLUS
	help
	   Support for the SPI bus on Gallus. You need this for SPI flash
	   or to talk to some voice SLICs.	
config SOLOS_MINIMUM_CODE
        bool "Minimum Kernel Code"
        default y
	depends on ARCH_SOLOS_GALLUS || ARCH_SOLOSW_GALLUS
        help
          Comment out some of the functionlity of Linux Kernel for code
          optimization 
endmenu


endif
```

## pool/bootstrap/target/linux/hi35xx/files-2.6.32/arch/arm/mach-hi3515v100/Kconfig
```kconfig
menu "Board Features"

config HISILICON_KCONSOLE
	int "Kernel console( 0 => UART0, 1 => UART1)"
	range 0 1
	default 0
	help
	  Select uart port as the default console used by kernel

config HISILICON_EDB_LEVEL
	int "Kernel Early-Debug Level( 0~254, 255 => Disable Early-Debug)"
	range 0 255
	default 255
	help
	  Set the debug level of Early-Debug, low level will cause more debug message

config DEFAULT_MPLLIN
	int "Main XTAL clock"
	default 24000000
	help
	  OSC clock of chip on board, whitch is the input of Main PLL

config DEFAULT_BUSCLK
	int "Default AHB rate"
	default 2000000000
	help
	  Default AHB clock rate

config CPUCLK_MULTI
	int "ARMCore clock scale"
	range 1 3 
	default 3
	help
	  ARMCore clock is 1 or 2 times of the AHB clock.

config HISILICON_GPIO_CPU_LED
	int "GPIO for CPU Led"
	depends on LEDS_CPU
	range 0 199
	default 16
	help
	  One GPIO used to ctrol a LED, whitch used to show the useage of CPU
endmenu
```

## pool/feeds/xorg/xserver/microwin/microwin-20110220/Config.in
```kconfig
menu "Nano-X Feature Support"
depends on PACKAGE_microwin

choice
	prompt "Machine Type"
	default NANOX_MACH_GENERIC

config NANOX_MACHINE_GENERIC
	bool "Generic"
	help
	  Please select it if you don't know which is your machine.

config NANOX_MACHINE_VIRTUALBOX
	bool "VirtualBox"
	depends on TARGET_x86
	help
	  Please select it if you run Nano-X on VirtualBox VM.

config NANOX_MACHINE_COLINUX
	bool "CoLinux"
	depends on TARGET_x86
	help
	  Please select it if you run Nano-X on CoLinux VM.

endchoice

choice
	prompt "Mouse Device"
	default NANOX_MOUSE_NONE

config NANOX_MOUSE_NONE
	bool "None"
	help
	  Please select it if you don't have a mouse device on Nano-X.

endchoice

choice
	prompt "Keyboard Device"
	default NANOX_KEYBOARD_NONE

config NANOX_KEYBOARD_NONE
	bool "None"
	help
	  Please select it if you don't have a keyboard device on Nano-X.

endchoice

endmenu
```
